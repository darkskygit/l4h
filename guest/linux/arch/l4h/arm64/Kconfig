## guest/linux/arch/l4h/arm64/Kconfig
```kconfig
# SPDX-License-Identifier: GPL-2.0
config UML_ARM64
	def_bool $(success,test "$(SUBARCH)" = "aarch64")

if UML_ARM64
config 64BIT
	def_bool y
config ARM64
	def_bool y
	select CLONE_BACKWARDS
	select GENERIC_CPU_AUTOPROBE
	select HAVE_EFFICIENT_UNALIGNED_ACCESS
	select ARCH_WANT_DEFAULT_BPF_JIT
	select HAVE_EBPF_JIT
	select HAVE_MOD_ARCH_SPECIFIC
	select MODULES_USE_ELF_RELA
config KERNEL_MODE_NEON
	def_bool y
	help
	  Kernel-mode NEON (kernel_neon_begin/end, arch/l4h/arm64/neon.c)
	  works in the guest kernel, so the arm64 crypto algorithms in
	  arch/arm64/crypto (ARMv8 Crypto Extensions AES and others) can be
	  selected.
config ARM64_LSE_ATOMICS
	def_bool y
	help
	  Build the ARMv8.1 LSE atomics encoders and emitter of the BPF JIT
	  (arch/arm64/lib/insn.c, arch/arm64/net), which it uses when the CPU
	  has them (HWCAP_ATOMICS, cpus_have_cap()).  The guest kernel's own
	  atomics (arch/l4h/arm64/asm/atomic.h) do not use this option.
config GENERIC_HWEIGHT
	def_bool y
config GENERIC_CSUM
	def_bool y
endif
```

## guest/linux/arch/l4h/configs/defconfig
```kconfig
CONFIG_LOCALVERSION="-l4h"
# CONFIG_LOCALVERSION_AUTO is not set
CONFIG_SYSVIPC=y
CONFIG_POSIX_MQUEUE=y
CONFIG_NO_HZ_IDLE=y
CONFIG_HIGH_RES_TIMERS=y
CONFIG_PREEMPT_VOLUNTARY=y
CONFIG_IKCONFIG=y
CONFIG_IKCONFIG_PROC=y
CONFIG_LOG_BUF_SHIFT=16
CONFIG_CGROUPS=y
CONFIG_BLK_DEV_INITRD=y
CONFIG_EXPERT=y
CONFIG_SMP=y
CONFIG_NR_CPUS=64
CONFIG_HZ_250=y
CONFIG_MODULES=y
CONFIG_MODULE_UNLOAD=y
CONFIG_BINFMT_ELF=y
CONFIG_BINFMT_SCRIPT=y
CONFIG_NET=y
CONFIG_PACKET=y
CONFIG_UNIX=y
CONFIG_INET=y
CONFIG_DEVTMPFS=y
CONFIG_DEVTMPFS_MOUNT=y
CONFIG_BLK_DEV=y
CONFIG_BLK_DEV_LOOP=y
CONFIG_TTY=y
CONFIG_PRINTK=y
CONFIG_PROC_FS=y
CONFIG_SYSFS=y
CONFIG_TMPFS=y
CONFIG_EXT4_FS=y
# CONFIG_INPUT is not set
# CONFIG_VT is not set
# CONFIG_HW_RANDOM is not set
CONFIG_MAGIC_SYSRQ=y
CONFIG_DEBUG_INFO_DWARF_TOOLCHAIN_DEFAULT=y
CONFIG_FRAME_POINTER=y
CONFIG_PANIC_TIMEOUT=-1
CONFIG_SOFTLOCKUP_DETECTOR=y
CONFIG_DETECT_HUNG_TASK=y
CONFIG_DEFAULT_HUNG_TASK_TIMEOUT=20
CONFIG_RCU_CPU_STALL_TIMEOUT=10
CONFIG_VIRTIO_BLK=y
CONFIG_VIRTIO_NET=y
CONFIG_NETDEVICES=y
# Distributions (systemd) and containers.
CONFIG_NAMESPACES=y
CONFIG_UTS_NS=y
CONFIG_IPC_NS=y
CONFIG_PID_NS=y
CONFIG_NET_NS=y
CONFIG_USER_NS=y
# Time namespaces would need the vDSO data pages remapped per namespace;
# x86/vdso/vma.c maps one time page for all.
# CONFIG_TIME_NS is not set
CONFIG_MEMCG=y
CONFIG_CGROUP_SCHED=y
CONFIG_CGROUP_PIDS=y
CONFIG_CGROUP_FREEZER=y
CONFIG_CPUSETS=y
CONFIG_CGROUP_DEVICE=y
CONFIG_CGROUP_CPUACCT=y
CONFIG_BLK_CGROUP=y
CONFIG_BPF_SYSCALL=y
CONFIG_CGROUP_BPF=y
CONFIG_TMPFS_POSIX_ACL=y
CONFIG_TMPFS_XATTR=y
CONFIG_EXT4_FS_POSIX_ACL=y
CONFIG_EXT4_FS_SECURITY=y
CONFIG_AUTOFS_FS=y
CONFIG_FANOTIFY=y
CONFIG_PROC_CHILDREN=y
CONFIG_OVERLAY_FS=y
CONFIG_FUSE_FS=y
CONFIG_IPV6=y
CONFIG_VETH=y
CONFIG_TUN=y
CONFIG_BRIDGE=y
CONFIG_DUMMY=y
# A router VM (DESIGN.md §8.3) needs NAT.
CONFIG_NETFILTER=y
CONFIG_NF_CONNTRACK=y
CONFIG_NF_NAT=y
CONFIG_NF_TABLES=y
CONFIG_NF_TABLES_INET=y
CONFIG_NFT_CT=y
CONFIG_NFT_NAT=y
CONFIG_NFT_MASQ=y
CONFIG_IP_NF_IPTABLES=y
CONFIG_IP_NF_NAT=y
CONFIG_IP_NF_TARGET_MASQUERADE=y
CONFIG_IP_ADVANCED_ROUTER=y
# Encrypted disks: dm-crypt, using AES-NI on x86_64 (arch/l4h/x86/fpu.c) and
# the ARMv8 Crypto Extensions, or bit-sliced NEON without them, on aarch64
# (arch/l4h/arm64/neon.c).
CONFIG_MD=y
CONFIG_BLK_DEV_DM=y
CONFIG_DM_CRYPT=y
CONFIG_DM_ZERO=y
CONFIG_CRYPTO_AES=y
CONFIG_CRYPTO_XTS=y
CONFIG_CRYPTO_AES_NI_INTEL=y
CONFIG_CRYPTO_AES_ARM64_CE_BLK=y
CONFIG_CRYPTO_AES_ARM64_BS=y
# Attestation reports from the host (arch/l4h/drivers/attest.c) at
# /sys/kernel/config/tsm/report.
CONFIG_VIRT_DRIVERS=y
CONFIG_CONFIGFS_FS=y
# CONFIG_VMGENID is not set
```

## guest/linux/arch/l4h/x86/Kconfig
```kconfig
if !UML_ARM64
# SPDX-License-Identifier: GPL-2.0

menu "Host processor type and features"

source "arch/x86/Kconfig.cpu"

endmenu

config UML_X86
	def_bool y
	select DCACHE_WORD_ACCESS
	select HAVE_EFFICIENT_UNALIGNED_ACCESS

config 64BIT
	def_bool y

config L4H_X86_SIMD
	def_bool y
	help
	  Kernel-mode SIMD (kernel_fpu_begin/end, arch/l4h/x86/fpu.c) works
	  in the guest kernel, so the x86 crypto algorithms in
	  arch/x86/crypto (AES-NI and others) can be selected.

config X86_64
	def_bool y
	select MODULES_USE_ELF_RELA

config ARCH_HAS_SC_SIGNALS
	def_bool n

config ARCH_REUSE_HOST_VSYSCALL_AREA
	def_bool n

config GENERIC_HWEIGHT
	def_bool y

endif
```
